## example/sdkconfig.defaults
```kconfig
CONFIG_IDF_TARGET="esp32s2"
CONFIG_ESP_CONSOLE_USB_CDC=y
CONFIG_ESPTOOLPY_BEFORE_NORESET=y
CONFIG_ESPTOOLPY_AFTER_NORESET=y
CONFIG_LWIP_SNTP_MAX_SERVERS=16
CONFIG_LWIP_DHCP_GET_NTP_SRV=y
```
